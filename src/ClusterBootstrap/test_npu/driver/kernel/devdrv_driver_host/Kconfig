## src/ClusterBootstrap/test_npu/driver/kernel/devdrv_driver_host/Kconfig
```kconfig
source "drivers/hisi/npu/drivers/dev_core/device_manager/device_manager_slave/devdrv_driver_slave/Kconfig"

config HOST_DEVDRV_DEVDRIVER
	tristate "HOST DEVDRV DEVDRIVER"
	default m
```

## src/ClusterBootstrap/test_npu/driver/kernel/hdc_host/Kconfig
```kconfig
source "drivers/hisi/npu/drivers/dev_plat/hdcdrv/hdc_host/Kconfig"

config HOST_HDC_DEVDRV
	tristate "HOST HDC DEVDRV"
	default m
```

## src/ClusterBootstrap/test_npu/driver/kernel/libc_sec/src/Kconfig
```kconfig
config HISI_HW_SECUREC
        bool "Support Huawei Secure C"
        default n
        help
          This driver supports Huawei Secure C.
```
